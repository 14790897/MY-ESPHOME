## configs/actuators/door-espnow-idf/sdkconfig.defaults
```kconfig
# ESP-IDF 低功耗优化配置

# Flash: DIO 模式 (合宙 ESP32-C3 外置 Flash)
CONFIG_ESPTOOLPY_FLASHMODE_DIO=y
CONFIG_ESPTOOLPY_FLASHFREQ_80M=y
CONFIG_ESPTOOLPY_FLASHSIZE_4MB=y

# 关闭不需要的功能 (减小固件体积, 加速启动)
CONFIG_ESP_WIFI_SOFTAP_SUPPORT=n
CONFIG_ESP_WIFI_ENTERPRISE_SUPPORT=n
CONFIG_ESP_WIFI_NAN_ENABLE=n

# 日志级别 (发布时改为 WARN 或 NONE)
CONFIG_LOG_DEFAULT_LEVEL_INFO=y
# CONFIG_LOG_DEFAULT_LEVEL_WARN=y

# 优化启动速度
CONFIG_BOOTLOADER_LOG_LEVEL_WARN=y
CONFIG_BOOTLOADER_SKIP_VALIDATE_IN_DEEP_SLEEP=y
CONFIG_ESP_SLEEP_GPIO_RESET_WORKAROUND=n

# 电源管理
CONFIG_PM_ENABLE=y

# 关闭蓝牙 (不需要)
CONFIG_BT_ENABLED=n

# 减小栈大小 (节约 RAM)
CONFIG_ESP_MAIN_TASK_STACK_SIZE=4096

# NVS
CONFIG_NVS_ENCRYPTION=n
```
